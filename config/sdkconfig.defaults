## examples/esp-idf/audio-codec/main/Kconfig.projbuild
```kconfig
menu "Audio Codec Example Configuration"

    choice EXAMPLE_MODE
        prompt "Example mode"
        default EXAMPLE_MODE_MUSIC
        help
            Play the bundled PCM sample, or route the ES7210 FL/FR microphones
            through the BSP 24 kHz TDM voice profile to the ES8311 speaker.

        config EXAMPLE_MODE_MUSIC
            bool "Play bundled PCM sample"

        config EXAMPLE_MODE_ECHO
            bool "Echo FL/FR microphones to speaker (24 kHz TDM)"
    endchoice

    config EXAMPLE_VOICE_VOLUME
        int "Playback volume"
        range 0 100
        default 60
        help
            Set the ES8311 playback volume.

endmenu
```

## examples/esp-idf/audio-codec/sdkconfig.defaults
```kconfig
CONFIG_LV_USE_CLIB_MALLOC=y
CONFIG_LV_ASSERT_HANDLER_INCLUDE="assert.h"
CONFIG_PARTITION_TABLE_CUSTOM=y
CONFIG_PARTITION_TABLE_CUSTOM_FILENAME="partitions.csv"
```

## examples/esp-idf/usb-extended-screen/sdkconfig.defaults.esp32p4
```kconfig
CONFIG_IDF_TARGET="esp32p4"
CONFIG_BSP_LCD_TYPE_720_720_4_INCH=y
CONFIG_BSP_LCD_COLOR_FORMAT_RGB565=y
CONFIG_BSP_LCD_DPI_BUFFER_NUMS=3
CONFIG_LCD_PIXEL_FORMAT_RGB565=y
CONFIG_COMPILER_ORPHAN_SECTIONS_PLACE=y
CONFIG_ESP32P4_REV_MIN_1=y
CONFIG_SPIRAM=y
CONFIG_SPIRAM_SPEED_200M=y
CONFIG_FREERTOS_HZ=1000
CONFIG_IDF_EXPERIMENTAL_FEATURES=y
CONFIG_COMPILER_OPTIMIZATION_PERF=y
CONFIG_CACHE_L2_CACHE_256KB=y
CONFIG_CACHE_L2_CACHE_LINE_128B=y
CONFIG_CODEC_I2C_BACKWARD_COMPATIBLE=n
CONFIG_UAC_SPEAKER_CHANNEL_NUM=2
CONFIG_UAC_MIC_CHANNEL_NUM=2
CONFIG_UAC_SAMPLE_RATE=48000
CONFIG_UAC_BIT_RESOLUTION_16=y
CONFIG_USB_EXTEND_SCREEN_WIDTH=720
CONFIG_USB_EXTEND_SCREEN_HEIGHT=720
CONFIG_TINYUSB_RHPORT_HS=y
```

## examples/esp-idf/wifi-station/sdkconfig.defaults
```kconfig
CONFIG_ESP_WIFI_SOFTAP_SUPPORT=n
CONFIG_ESPTOOLPY_FLASHMODE_QIO=y
CONFIG_ESPTOOLPY_FLASHSIZE_32MB=y
CONFIG_ESPTOOLPY_FLASHSIZE="32MB"
CONFIG_SPIRAM=y
CONFIG_SPIRAM_SPEED_250M=y
CONFIG_ESP_WIFI_REMOTE_ENABLED=y
CONFIG_SLAVE_IDF_TARGET_ESP32C6=y
CONFIG_ESP_HOSTED_CP_TARGET_ESP32C6=y
CONFIG_ESP_HOSTED_P4_DEV_BOARD_FUNC_BOARD=y
CONFIG_ESP_HOSTED_MEMPOOL_PREFER_SPIRAM=y
```

## firmware/brookesia/archive/components/AIChats/Kconfig
```kconfig
menu "Xiaozhi Application"

    config XIAOZHI_OTA_URL
        string "Xiaozhi service URL"
        default "https://api.tenclass.net/xiaozhi/ota/"
        help
            Endpoint used to fetch activation and protocol configuration.

    config XIAOZHI_INFO_TIMEOUT_MS
        int "Service request timeout (ms)"
        range 1000 30000
        default 30000

    config XIAOZHI_INFO_BUFFER_SIZE
        int "Service request buffer size (bytes)"
        range 512 8192
        default 4096
        help
            Kept for sdkconfig compatibility with earlier firmware.

    config XIAOZHI_INFO_MAX_RESPONSE_SIZE
        int "Maximum service response size (bytes)"
        range 1024 16384
        default 8192

    config AICHATS_WEBSOCKET_HANDSHAKE_TIMEOUT_MS
        int "WebSocket hello timeout (ms)"
        range 1000 30000
        default 10000

    config AICHATS_WEBSOCKET_MAX_MESSAGE_SIZE
        int "Maximum WebSocket message size (bytes)"
        range 2048 65536
        default 16384

endmenu
```
